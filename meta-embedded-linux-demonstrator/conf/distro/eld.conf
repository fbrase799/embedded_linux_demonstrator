## meta-embedded-linux-demonstrator/conf/layer.conf
```bitbake
BBPATH .= ":${LAYERDIR}"

BBFILES += "${LAYERDIR}/recipes-*/*/*.bb \
            ${LAYERDIR}/recipes-*/*/*.bbappend"

BBFILE_COLLECTIONS += "embedded-linux-demonstrator"
BBFILE_PATTERN_embedded-linux-demonstrator = "^${LAYERDIR}/"
BBFILE_PRIORITY_embedded-linux-demonstrator = "10"

LAYERSERIES_COMPAT_embedded-linux-demonstrator = "scarthgap"

LAYERDEPENDS_embedded-linux-demonstrator = "core openembedded-layer raspberrypi qt6-layer"
```
